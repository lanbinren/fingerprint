## P-REE/alps/kernel-4.9/drivers/misc/mediatek/sunwave_tee/Kconfig
```kconfig
config MTK_FINGERPRINT_SUNWAVE_REE_TEE_ALL
       tristate "Sunwave Fingerprint"
       default n
       help
          SUNWAVECORP Fingerprint
```
